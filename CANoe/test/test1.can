/*@!Encoding:949*/
includes
{
  
}

variables
{
  
}


testcase MainTest()
{
  write("=== MainTest 시작 ===");
  
}