/*@!Encoding:949*/
includes
{
  
}

variables
{
  
}

testcase MainTest()
{
      testCaseFail();
}