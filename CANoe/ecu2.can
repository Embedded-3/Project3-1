/*@!Encoding:65001*/
includes
{
  
}

variables
{
    message msg2 msg;

}

on busOff
{
  
}

on message msg1
{
  syssetvariableint(sysvar::myNamespace::light, this.bsSwitch);

  msg.sig_motor = 4000;
  write("received msg1, sent msg2");
  output(msg);
  
}

on message msg2
{
  syssetvariableint(sysvar::myNamespace::motor, this.sig_motor);
  write("msg2 received");
  
}

