VERSION ""

NS_ :

BS_:

BU_:

BO_ 512 msg2: 8 Vector__XXX
 SG_ sig_motor : 0|12@1+ (1,0) [0|4095] "" Vector__XXX

BO_ 256 msg1: 8 Vector__XXX
 SG_ bsSwitch : 0|1@1+ (1,0) [0|1] "" Vector__XXX
